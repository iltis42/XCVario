## components/ESP32-OTA-Webserver/Kconfig.projbuild
```kconfig
menu "OTA WiFi Configuration"

config STATION_SSID
    string "Station SSID"
	default ""
	help
		SSID (network name) for the example to connect to.

config STATION_PASSPHRASE
    string "Station Passphrase"
	default ""
	help
		WiFi password (WPA or WPA2) for the example to use.

		Can be left blank if the network has no security set.

config AP_SSID
    string "AP SSID"
	default "ESP32 OTA"
	help
		AP SSID (network name) for the ESP32 to act as a AP

config AP_PASSPHARSE
    string "AP Passphrase"
	default "12345678"
	help
		AP password (WPA or WPA2) to use.

		Can be left blank if the network has no security set.

endmenu
```

## components/I2Cbus/examples/sdkconfig.defaults
```kconfig
#
# I2Cbus
#
CONFIG_I2CBUS_LOG_ERRORS=y
CONFIG_I2CBUS_LOG_READWRITES=y
CONFIG_I2CBUS_LOG_RW_LEVEL_INFO=y
CONFIG_I2CBUS_LOG_RW_LEVEL_DEBUG=
CONFIG_I2CBUS_LOG_RW_LEVEL_VERBOSE=
```

## main/Kconfig.projbuild
```kconfig
menu "Webserver"
    config WEBSERVER_USE_GZIP
            bool "Use gzip compressed web assets"
            default true
            help
                Saves approxemately 22kB flash by using gzip compressed html / css files

endmenu
```

## sdkconfig.defaults
```kconfig
configMAX_PRIORITIES=25
#
# Log
#
CONFIG_BOOTLOADER_LOG_LEVEL_WARN=y
# CONFIG_BOOTLOADER_LOG_LEVEL_INFO is not set
CONFIG_BOOTLOADER_LOG_LEVEL=2



#



#
# Debug Log Configuration
#
# CONFIG_ARDUHAL_LOG_DEFAULT_LEVEL_ERROR is not set
CONFIG_ARDUHAL_LOG_DEFAULT_LEVEL_INFO=y
CONFIG_ARDUHAL_LOG_DEFAULT_LEVEL=3


#
# Serial flasher config
#
CONFIG_ESPTOOLPY_FLASHMODE_QOUT=y
CONFIG_ESPTOOLPY_FLASHSIZE_4MB=y
CONFIG_ESPTOOLPY_FLASHSIZE="4MB"

#
# Partition Table
#
# CONFIG_PARTITION_TABLE_SINGLE_APP is not set
CONFIG_PARTITION_TABLE_CUSTOM=y
CONFIG_PARTITION_TABLE_CUSTOM_FILENAME="partitions.csv"


#
# Compiler options
#
# CONFIG_COMPILER_OPTIMIZATION_DEFAULT is not set
CONFIG_COMPILER_OPTIMIZATION_SIZE=y
# CONFIG_COMPILER_OPTIMIZATION_ASSERTIONS_ENABLE is not set
CONFIG_COMPILER_OPTIMIZATION_ASSERTIONS_DISABLE=y
CONFIG_COMPILER_OPTIMIZATION_ASSERTION_LEVEL=0
CONFIG_COMPILER_CXX_RTTI=y
# CONFIG_COMPILER_STACK_CHECK_MODE_NONE is not set
CONFIG_COMPILER_STACK_CHECK_MODE_NORM=y
CONFIG_COMPILER_STACK_CHECK=y

#
# Bluetooth
#
CONFIG_BT_ENABLED=y
CONFIG_BT_ALARM_MAX_NUM=20

#
# Bluetooth controller
#
# CONFIG_BTDM_CTRL_MODE_BLE_ONLY is not set
# CONFIG_BTDM_CTRL_MODE_BR_EDR_ONLY is not set
CONFIG_BTDM_CTRL_MODE_BTDM=y
CONFIG_BTDM_CTRL_BLE_MAX_CONN=3
CONFIG_BTDM_CTRL_BR_EDR_MAX_ACL_CONN=2
CONFIG_BTDM_CTRL_BR_EDR_MAX_SYNC_CONN=0
# CONFIG_BTDM_CTRL_BR_EDR_SCO_DATA_PATH_HCI is not set
CONFIG_BTDM_CTRL_BR_EDR_SCO_DATA_PATH_PCM=y
CONFIG_BTDM_CTRL_BR_EDR_SCO_DATA_PATH_EFF=1
CONFIG_BTDM_CTRL_PCM_ROLE_EDGE_CONFIG=y
CONFIG_BTDM_CTRL_PCM_ROLE_MASTER=y
# CONFIG_BTDM_CTRL_PCM_ROLE_SLAVE is not set
CONFIG_BTDM_CTRL_PCM_POLAR_FALLING_EDGE=y
# CONFIG_BTDM_CTRL_PCM_POLAR_RISING_EDGE is not set
CONFIG_BTDM_CTRL_PCM_ROLE_EFF=0
CONFIG_BTDM_CTRL_PCM_POLAR_EFF=0
# CONFIG_BTDM_CTRL_AUTO_LATENCY is not set
CONFIG_BTDM_CTRL_LEGACY_AUTH_VENDOR_EVT=y
CONFIG_BTDM_CTRL_LEGACY_AUTH_VENDOR_EVT_EFF=y
CONFIG_BTDM_CTRL_BLE_MAX_CONN_EFF=3
CONFIG_BTDM_CTRL_BR_EDR_MAX_ACL_CONN_EFF=2
CONFIG_BTDM_CTRL_BR_EDR_MAX_SYNC_CONN_EFF=0
CONFIG_BTDM_CTRL_PINNED_TO_CORE=0
CONFIG_BTDM_CTRL_HCI_MODE_VHCI=y
# CONFIG_BTDM_CTRL_HCI_MODE_UART_H4 is not set

#
# MODEM SLEEP Options
#
CONFIG_BTDM_CTRL_MODEM_SLEEP=y
CONFIG_BTDM_CTRL_MODEM_SLEEP_MODE_ORIG=y
# CONFIG_BTDM_CTRL_MODEM_SLEEP_MODE_EVED is not set
CONFIG_BTDM_CTRL_LPCLK_SEL_MAIN_XTAL=y
# end of MODEM SLEEP Options

CONFIG_BTDM_BLE_DEFAULT_SCA_250PPM=y
CONFIG_BTDM_BLE_SLEEP_CLOCK_ACCURACY_INDEX_EFF=1
CONFIG_BTDM_BLE_SCAN_DUPL=y
CONFIG_BTDM_SCAN_DUPL_TYPE_DEVICE=y
# CONFIG_BTDM_SCAN_DUPL_TYPE_DATA is not set
# CONFIG_BTDM_SCAN_DUPL_TYPE_DATA_DEVICE is not set
CONFIG_BTDM_SCAN_DUPL_TYPE=0
CONFIG_BTDM_SCAN_DUPL_CACHE_SIZE=200
# CONFIG_BTDM_BLE_MESH_SCAN_DUPL_EN is not set
CONFIG_BTDM_CTRL_FULL_SCAN_SUPPORTED=y
CONFIG_BTDM_BLE_ADV_REPORT_FLOW_CTRL_SUPP=y
CONFIG_BTDM_BLE_ADV_REPORT_FLOW_CTRL_NUM=100
CONFIG_BTDM_BLE_ADV_REPORT_DISCARD_THRSHOLD=20
CONFIG_BTDM_RESERVE_DRAM=0xdb5c
# end of Bluetooth controller

CONFIG_BT_BLUEDROID_ENABLED=y
# CONFIG_BT_NIMBLE_ENABLED is not set
# CONFIG_BT_CONTROLLER_ONLY is not set

#
# Bluedroid Options
#
CONFIG_BT_BTC_TASK_STACK_SIZE=3072
CONFIG_BT_BLUEDROID_PINNED_TO_CORE=0
CONFIG_BT_BTU_TASK_STACK_SIZE=4096
# CONFIG_BT_BLUEDROID_MEM_DEBUG is not set
CONFIG_BT_CLASSIC_ENABLED=y
# CONFIG_BT_A2DP_ENABLE is not set
CONFIG_BT_SPP_ENABLED=y
# CONFIG_BT_HFP_ENABLE is not set
# CONFIG_BT_HID_ENABLED is not set
CONFIG_BT_SSP_ENABLED=y
CONFIG_BT_BLE_ENABLED=y
CONFIG_BT_GATTS_ENABLE=y
CONFIG_BT_GATTS_PPCP_CHAR_GAP=y
# CONFIG_BT_BLE_BLUFI_ENABLE is not set
CONFIG_BT_GATT_MAX_SR_PROFILES=8
# CONFIG_BT_GATTS_SEND_SERVICE_CHANGE_MANUAL is not set
CONFIG_BT_GATTS_SEND_SERVICE_CHANGE_AUTO=y
CONFIG_BT_GATTS_SEND_SERVICE_CHANGE_MODE=0
# CONFIG_BT_GATTC_ENABLE is not set
CONFIG_BT_BLE_SMP_ENABLE=y
CONFIG_BT_SMP_SLAVE_CON_PARAMS_UPD_ENABLE=y
CONFIG_BT_STACK_NO_LOG=y
CONFIG_BT_ACL_CONNECTIONS=2
CONFIG_BT_MULTI_CONNECTION_ENBALE=y
# CONFIG_BT_ALLOCATION_FROM_SPIRAM_FIRST is not set
CONFIG_BT_BLE_DYNAMIC_ENV_MEMORY=y
# CONFIG_BT_BLE_HOST_QUEUE_CONG_CHECK is not set
CONFIG_BT_SMP_ENABLE=y
# CONFIG_BT_BLE_ACT_SCAN_REP_ADV_SCAN is not set
CONFIG_BT_BLE_ESTAB_LINK_CONN_TOUT=30
CONFIG_BT_MAX_DEVICE_NAME_LEN=32
# CONFIG_BT_BLE_RPA_SUPPORTED is not set
# end of Bluedroid Options
# end of Bluetooth


#
# TWAI configuration
#
CONFIG_TWAI_ISR_IN_IRAM=y
# end of TWAI Configuration


# CONFIG_BLE_MESH is not set

#
# SPI configuration
#
CONFIG_SPI_MASTER_IN_IRAM=y
# CONFIG_SPI_SLAVE_IN_IRAM is not set
# CONFIG_SPI_SLAVE_ISR_IN_IRAM is not set
# end of SPI Configuration

#
# UART configuration
#
CONFIG_UART_ISR_IN_IRAM=y

#
# RTCIO configuration
#
CONFIG_RTCIO_SUPPORT_RTC_GPIO_DESC=y

#
# ESP32-specific
#
# CONFIG_ESP32_REV_MIN_0 is not set
CONFIG_ESP32_REV_MIN_1=y
CONFIG_ESP32_REV_MIN=1
# CONFIG_ESP32_DEBUG_OCDAWARE is not set
CONFIG_ESP32_DEEP_SLEEP_WAKEUP_DELAY=0
CONFIG_ESP32_XTAL_FREQ_40=y
# CONFIG_ESP32_XTAL_FREQ_AUTO is not set
# CONFIG_ESP32_RTCDATA_IN_FAST_MEM is not set
# CONFIG_ESP32_IRAM_AS_8BIT_ACCESSIBLE_MEMORY is not set
# CONFIG_ETH_USE_SPI_ETHERNET is not set

CONFIG_ESP_SLEEP_POWER_DOWN_FLASH=y
CONFIG_ESP_IPC_TASK_STACK_SIZE=1024
CONFIG_ESP_PHY_REDUCE_TX_POWER=y

#
# Common ESP-related
#
CONFIG_ESP_SYSTEM_RTC_FAST_MEM_AS_HEAP_DEPCHECK=y
CONFIG_ESP_SYSTEM_ALLOW_RTC_FAST_MEM_AS_HEAP=y
CONFIG_ESP_SYSTEM_EVENT_TASK_STACK_SIZE=2048
CONFIG_ESP_MAIN_TASK_STACK_SIZE=8192
# CONFIG_ESP_INT_WDT is not set
CONFIG_ESP_TASK_WDT_PANIC=y
CONFIG_ESP_TASK_WDT_TIMEOUT_S=10
# CONFIG_ESP_TASK_WDT_CHECK_IDLE_TASK_CPU0 is not set

#
# High resolution timer (esp_timer)
#
CONFIG_ESP_TIMER_PROFILING=n
CONFIG_ESP_TIMER_TASK_STACK_SIZE=8192

#
# ESP-Driver:GPTimer Configurations
#
# CONFIG_GPTIMER_ISR_HANDLER_IN_IRAM is not set

#
# Wi-Fi
#
# CONFIG_ESP32_WIFI_SW_COEXIST_ENABLE is not set
# CONFIG_ESP32_WIFI_ENABLE_WPA3_SAE is not set
# CONFIG_ESP_WIFI_IRAM_OPT is not set

#
# Core dump
#
CONFIG_ESP_COREDUMP_ENABLE_TO_FLASH=y
# CONFIG_ESP_COREDUMP_ENABLE_TO_NONE is not set
# CONFIG_ESP_COREDUMP_DATA_FORMAT_BIN is not set
CONFIG_ESP_COREDUMP_DATA_FORMAT_ELF=y
CONFIG_ESP_COREDUMP_CHECKSUM_CRC32=y
# CONFIG_ESP_COREDUMP_CHECKSUM_SHA256 is not set
CONFIG_ESP_COREDUMP_CHECK_BOOT=y
CONFIG_ESP_COREDUMP_ENABLE=y
CONFIG_ESP_COREDUMP_MAX_TASKS_NUM=64

#
# Modbus configuration
#
CONFIG_FMB_TCP_PORT_MAX_CONN=6
CONFIG_FMB_PORT_TASK_AFFINITY=0x7FFFFFFF
# CONFIG_FMB_CONTROLLER_SLAVE_ID_SUPPORT is not set
CONFIG_FMB_TIMER_PORT_ENABLED=y

#
# FreeRTOS
#
# CONFIG_FREERTOS_UNICORE is not set
CONFIG_FREERTOS_OPTIMIZED_SCHEDULER=y
CONFIG_FREERTOS_HZ=1000
CONFIG_FREERTOS_CHECK_STACKOVERFLOW_NONE=y
# CONFIG_FREERTOS_CHECK_STACKOVERFLOW_CANARY is not set
CONFIG_FREERTOS_WATCHPOINT_END_OF_STACK=y
CONFIG_FREERTOS_THREAD_LOCAL_STORAGE_POINTERS=3
CONFIG_FREERTOS_ASSERT_DISABLE=y
CONFIG_FREERTOS_USE_TRACE_FACILITY=y
CONFIG_FREERTOS_USE_STATS_FORMATTING_FUNCTIONS=y
CONFIG_FREERTOS_VTASKLIST_INCLUDE_COREID=y

#
# Hardware Abstraction Layer (HAL) and Low Level (LL)
#
# CONFIG_HAL_SPI_MASTER_FUNC_IN_IRAM is not set
# CONFIG_HAL_SPI_SLAVE_FUNC_IN_IRAM is not set
# end of Hardware Abstraction Layer (HAL) and Low Level (LL)

#
# Format
#
# CONFIG_LOG_COLORS is not set
# CONFIG_LOG_TIMESTAMP_SOURCE_RTOS is not set
CONFIG_LOG_TIMESTAMP_SOURCE_SYSTEM=y
# end of Format
# end of Log

#
# LWIP
#
CONFIG_LWIP_MAX_SOCKETS=16

CONFIG_LWIP_ETHARP_TRUST_IP_MAC=y


#
# DHCP server
#
CONFIG_LWIP_DHCPS_LEASE_UNIT=300

#
# TCP
#
CONFIG_LWIP_TCP_MAXRTX=6
CONFIG_LWIP_TCP_SYNMAXRTX=6
CONFIG_LWIP_TCP_MSS=540
CONFIG_LWIP_TCP_MSL=6000
CONFIG_LWIP_TCP_SND_BUF_DEFAULT=2440
CONFIG_LWIP_TCP_WND_DEFAULT=2440
CONFIG_LWIP_TCP_RECVMBOX_SIZE=10

#
# UDP
#
CONFIG_LWIP_MAX_UDP_PCBS=32

#
# Checksums
#
CONFIG_LWIP_TCPIP_TASK_STACK_SIZE=2560

#
# LWIP RAW API
#
CONFIG_LWIP_MAX_RAW_PCBS=32

#
# DTLS-based configurations
#
# CONFIG_MBEDTLS_SSL_DTLS_CONNECTION_ID is not set
# CONFIG_MBEDTLS_SSL_DTLS_SRTP is not set
# end of DTLS-based configurations

#
# Certificate Bundle
#
# CONFIG_MBEDTLS_CERTIFICATE_BUNDLE_DEFAULT_FULL is not set
CONFIG_MBEDTLS_CERTIFICATE_BUNDLE_DEFAULT_CMN=y

#
# TLS Key Exchange Methods
#
CONFIG_MBEDTLS_PSK_MODES=y
CONFIG_MBEDTLS_KEY_EXCHANGE_PSK=y
CONFIG_MBEDTLS_KEY_EXCHANGE_DHE_PSK=y
CONFIG_MBEDTLS_KEY_EXCHANGE_ECDHE_PSK=y
CONFIG_MBEDTLS_KEY_EXCHANGE_RSA_PSK=y
CONFIG_MBEDTLS_SSL_PROTO_DTLS=y

#
# ESP-MQTT Configurations
#
# CONFIG_MQTT_PROTOCOL_311 is not set
# CONFIG_MQTT_TRANSPORT_SSL is not set
# CONFIG_MQTT_TRANSPORT_WEBSOCKET is not set

#
# OpenSSL
#
CONFIG_OPENSSL_ASSERT_DO_NOTHING=y
# CONFIG_OPENSSL_ASSERT_EXIT is not set

#
# PThreads
#
CONFIG_PTHREAD_TASK_STACK_SIZE_DEFAULT=2048

#
# SPI Flash driver
#
CONFIG_SPI_FLASH_VERIFY_WRITE=y

#
# Virtual file system
#
# CONFIG_VFS_SUPPORT_IO is not set
# end of Virtual file system

#
# Wi-Fi Provisioning Manager
#
CONFIG_WIFI_PROV_BLE_BONDING=y

# Deprecated options for backward compatibility
# CONFIG_WIFI_PROV_KEEP_BLE_ON_AFTER_PROV is not set
CONFIG_LOG_BOOTLOADER_LEVEL_WARN=y
# CONFIG_LOG_BOOTLOADER_LEVEL_INFO is not set
CONFIG_LOG_BOOTLOADER_LEVEL=2
CONFIG_FLASHMODE_QOUT=y
# CONFIG_FLASHMODE_DIO is not set
# CONFIG_COMPILER_OPTIMIZATION_LEVEL_DEBUG is not set
CONFIG_COMPILER_OPTIMIZATION_LEVEL_RELEASE=y
# CONFIG_OPTIMIZATION_ASSERTIONS_ENABLED is not set
CONFIG_OPTIMIZATION_ASSERTIONS_DISABLED=y
CONFIG_OPTIMIZATION_ASSERTION_LEVEL=0
# CONFIG_STACK_CHECK_NONE is not set
CONFIG_STACK_CHECK_NORM=y
CONFIG_STACK_CHECK=y
CONFIG_BLUEDROID_ENABLED=y
# CONFIG_NIMBLE_ENABLED is not set
CONFIG_BTC_TASK_STACK_SIZE=3072
CONFIG_BLUEDROID_PINNED_TO_CORE=0
CONFIG_BTU_TASK_STACK_SIZE=4096
# CONFIG_BLUEDROID_MEM_DEBUG is not set
CONFIG_CLASSIC_BT_ENABLED=y
# CONFIG_A2DP_ENABLE is not set
# CONFIG_HFP_ENABLE is not set
CONFIG_GATTS_ENABLE=y
# CONFIG_GATTS_SEND_SERVICE_CHANGE_MANUAL is not set
CONFIG_GATTS_SEND_SERVICE_CHANGE_AUTO=y
CONFIG_GATTS_SEND_SERVICE_CHANGE_MODE=0
# CONFIG_GATTC_ENABLE is not set
CONFIG_BLE_SMP_ENABLE=y
CONFIG_SMP_SLAVE_CON_PARAMS_UPD_ENABLE=y
# CONFIG_BLE_HOST_QUEUE_CONGESTION_CHECK is not set
CONFIG_SMP_ENABLE=y
# CONFIG_BLE_ACTIVE_SCAN_REPORT_ADV_SCAN_RSP_INDIVIDUALLY is not set
CONFIG_BLE_ESTABLISH_LINK_CONNECTION_TIMEOUT=30
CONFIG_SYSTEM_EVENT_TASK_STACK_SIZE=2048
CONFIG_MAIN_TASK_STACK_SIZE=8192
CONFIG_INT_WDT=y
CONFIG_INT_WDT_TIMEOUT_MS=2000
CONFIG_TASK_WDT_PANIC=y
CONFIG_TASK_WDT_TIMEOUT_S=10
# CONFIG_TASK_WDT_CHECK_IDLE_TASK_CPU0 is not set
CONFIG_TIMER_TASK_STACK_SIZE=8192
# CONFIG_SW_COEXIST_ENABLE is not set
CONFIG_ESP32_ENABLE_COREDUMP_TO_FLASH=y
# CONFIG_ESP32_ENABLE_COREDUMP_TO_NONE is not set
# CONFIG_ESP32_COREDUMP_DATA_FORMAT_BIN is not set
CONFIG_ESP32_COREDUMP_DATA_FORMAT_ELF=y
CONFIG_ESP32_COREDUMP_CHECKSUM_CRC32=y
# CONFIG_ESP32_COREDUMP_CHECKSUM_SHA256 is not set
CONFIG_ESP32_ENABLE_COREDUMP=y
CONFIG_ESP32_CORE_DUMP_MAX_TASKS_NUM=64
# CONFIG_MB_CONTROLLER_SLAVE_ID_SUPPORT is not set
CONFIG_MB_TIMER_PORT_ENABLED=y
CONFIG_TIMER_TASK_STACK_DEPTH=4096
CONFIG_TCP_MAXRTX=6
CONFIG_TCP_SYNMAXRTX=6
CONFIG_TCP_MSS=540
CONFIG_TCP_MSL=6000
CONFIG_TCP_SND_BUF_DEFAULT=2440
CONFIG_TCP_WND_DEFAULT=2440
CONFIG_TCP_RECVMBOX_SIZE=10
CONFIG_TCPIP_TASK_STACK_SIZE=2560
CONFIG_ESP32_PTHREAD_TASK_STACK_SIZE_DEFAULT=2048
```
